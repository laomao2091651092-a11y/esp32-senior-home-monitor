## s3_link_device/sdkconfig.defaults
```kconfig
CONFIG_ESP32S3_DEFAULT_CPU_FREQ_240=y
CONFIG_ESP_TASK_WDT=y
CONFIG_FREERTOS_HZ=1000
CONFIG_LWIP_DHCP_DOES_ARP_CHECK=n
CONFIG_ESP_WIFI_MODE_STA=y
CONFIG_MQTT_PROTOCOL_311=y
```
